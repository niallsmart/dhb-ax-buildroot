// SPDX-License-Identifier: GPL-2.0-only
/*
 * Minimal RAM-only bring-up: CPU, GIC, SP804 timer, PL011 UART0 only.
 *
 * Developed against an LTS LTD2704XE-P; the same board also ships under
 * other retail brands.
 */
/dts-v1/;

#include "hi3531.dtsi"

/ {
	model = "TVT DHB_AX V1.2 (Hi3531 DVR, minimal)";
	compatible = "tvt,dhb-ax", "hisilicon,hi3531";
};
